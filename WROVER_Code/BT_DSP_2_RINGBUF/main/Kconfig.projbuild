## WROVER_Code/BT_DSP_2_RINGBUF/main/Kconfig.projbuild
```kconfig
menu "A2DP Example Configuration"

    config EXAMPLE_I2S_LRCK_PIN
        int "I2S LRCK (WS) GPIO"
        default 22
        depends on WROVER_BT_NOBLOAT_EXTERNAL_I2S
        help
            GPIO number to use for I2S LRCK(WS) Driver.

    config EXAMPLE_I2S_BCK_PIN
        int "I2S BCK GPIO"
        default 26
        depends on WROVER_BT_NOBLOAT_EXTERNAL_I2S
        help
            GPIO number to use for I2S BCK Driver.

    config EXAMPLE_I2S_DATA_PIN
        int "I2S DATA GPIO"
        default 25
        depends on WROVER_BT_NOBLOAT_EXTERNAL_I2S
        help
            GPIO number to use for I2S Data Driver.

endmenu
```
